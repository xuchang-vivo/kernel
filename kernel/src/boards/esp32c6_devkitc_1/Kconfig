## kernel/src/boards/esp32c6_devkitc_1/Kconfig
```kconfig
# Soc specific configuration
choice
    prompt "The irq priority bits"
    default IRQ_PRIORITY_BITS_2
    help
      Choose between 2, 3 or 8 for the irq priority bits.
    config IRQ_PRIORITY_BITS_2
        bool "2"
        help
          Set irq priority bits to 2.
    config IRQ_PRIORITY_BITS_3
        bool "3"
        help
          Set irq priority bits to 3.
    config IRQ_PRIORITY_BITS_8
        bool "8"
        help
          Set irq priority bits to 8.
endchoice

config SOC_ESP32C6
    bool "Esp32c6"
    default y
    select RISCV
    select HAS_MIE
    select I2C_CORE

config I2S
    bool "Enable I2S driver"
    default n
    help
      Enable the ESP32-C6 I2S0 register-level driver with GDMA support.
      Required for audio playback/capture on boards with I2S codecs
      (e.g. ES8311 on the Waveshare ESP32-C6 Touch AMOLED 2.16).

if I2S
config I2S_MCLK_GPIO
    int "I2S MCLK GPIO"
    default 19
    range 0 30
config I2S_BCLK_GPIO
    int "I2S BCLK GPIO"
    default 20
    range 0 30
config I2S_WS_GPIO
    int "I2S WS (LRCK) GPIO"
    default 22
    range 0 30
config I2S_DOUT_GPIO
    int "I2S DOUT (TX data) GPIO"
    default 23
    range 0 30
config I2S_DIN_GPIO
    int "I2S DIN (RX data) GPIO"
    default 21
    range 0 30

config ES8311_PA
    bool "Enable ES8311 external PA control GPIO"
    default n
    help
      Enable an external PA power-control GPIO for the ES8311 codec.
      The Waveshare ESP32-C6 Touch AMOLED 2.16 board config sets
      pa:-1 (no external PA), so this is disabled by default.

config ES8311_PA_GPIO
    int "ES8311 PA control GPIO"
    default 26
    range 0 30
    depends on ES8311_PA
    help
      GPIO pin used to enable/disable the external PA.
endif

config CST9220
    bool "Enable CST9220 touch controller"
    default n
    select I2C_CORE
    select USE_EMBEDDED_HAL_V1
    help
      Enable the CST9220 capacitive touch controller on the Waveshare
      ESP32-C6 Touch AMOLED 2.16-inch board.

config LCD
    bool "Enable LCD device"
    default n
    select SPI_CORE
    select USE_EMBEDDED_HAL_V1

if LCD
  choice
    prompt "LCD controller"
    default CO5300

    config CO5300
        bool "Enable LCD CO5300"
        help
          Enable the CO5300 QSPI AMOLED controller.
  endchoice

  if CO5300
    choice
      prompt "CO5300 panel"
      default CO5300_PANEL_216INCH

      config CO5300_PANEL_216INCH
        bool "2.16-inch AMOLED (480x480)"
      config CO5300_PANEL_AM196
        bool "AM196Q410502LK (410x502)"
      config CO5300_PANEL_AM178
        bool "AM178Q368448LK (368x448)"
      config CO5300_PANEL_AM151
        bool "AM151Q466466LK (466x466)"
      config CO5300_PANEL_AM200
        bool "AM200Q460460LK (460x460)"
      config CO5300_PANEL_H0198
        bool "H0198S005AMT005 (410x502)"
      config CO5300_PANEL_185INCH
        bool "1.85-inch AMOLED (390x450)"
    endchoice
  endif
endif

config USE_EMBEDDED_HAL_V1
    bool "Implement embedded-hal 1.0 adapters"
    default y

config CO5300_SCLK_GPIO
    int "CO5300 QSPI clock GPIO"
    default 0
    range 0 30
config CO5300_SIO0_GPIO
    int "CO5300 QSPI SIO0 GPIO"
    default 1
    range 0 30
config CO5300_SIO1_GPIO
    int "CO5300 QSPI SIO1 GPIO"
    default 2
    range 0 30
config CO5300_SIO2_GPIO
    int "CO5300 QSPI SIO2 GPIO"
    default 3
    range 0 30
config CO5300_SIO3_GPIO
    int "CO5300 QSPI SIO3 GPIO"
    default 4
    range 0 30
config CO5300_CS_GPIO
    int "CO5300 chip-select GPIO"
    default 15
    range 0 30

config CST9220_SDA_GPIO
    int "CST9220 I2C SDA GPIO"
    default 8
    range 0 30
config CST9220_SCL_GPIO
    int "CST9220 I2C SCL GPIO"
    default 7
    range 0 30
config CST9220_INT_GPIO
    int "CST9220 interrupt GPIO"
    default 5
    range 0 30
config CST9220_RST_GPIO
    int "CST9220 reset GPIO"
    default 11
    range 0 30

config NUM_IRQS
    default 31
```
